## board/senzacarta/mx7dsenzacarta/Kconfig
```kconfig
if TARGET_MX7DSENZACARTA

config SYS_BOARD
	default "mx7dsenzacarta"

config SYS_VENDOR
	default "senzacarta"

config SYS_CONFIG_NAME
	default "mx7dsenzacarta"

config SYS_TEXT_BASE
	default 0x87800000
endif
```
